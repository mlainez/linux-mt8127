## Documentation/devicetree/bindings/display/mediatek/mediatek,lvds.yaml
```yaml
# SPDX-License-Identifier: (GPL-2.0-only OR BSD-2-Clause)
%YAML 1.2
---
$id: http://devicetree.org/schemas/display/mediatek/mediatek,lvds.yaml#
$schema: http://devicetree.org/meta-schemas/core.yaml#

title: MediaTek LVDS Transmitter

maintainers:
  - Marc Lainez <marc.lainez@gmail.com>

description:
  The LVDS transmitter serializes the parallel RGB output of DPI0 on one
  LVDS link. Its PLL is fed by the MIPI TX PLL and also generates the DPI0
  pixel clock. The transmitter is made of a digital block in the display
  subsystem and an analog block next to the MIPI TX.

properties:
  compatible:
    const: mediatek,mt8127-lvds

  reg:
    items:
      - description: LVDS TX digital registers
      - description: LVDS TX analog and LVDS PLL registers

  reg-names:
    items:
      - const: tx
      - const: ana

  clocks:
    items:
      - description: LVDS pixel clock gate
      - description: LVDS CTS clock gate
      - description: MIPI TX PLL feeding the LVDS PLL

  clock-names:
    items:
      - const: pixel
      - const: cts
      - const: pll

  power-domains:
    maxItems: 1

  mediatek,mmsys:
    $ref: /schemas/types.yaml#/definitions/phandle
    description: The MMSYS_CONFIG system controller, which gates the LVDS
      output.

  ports:
    $ref: /schemas/graph.yaml#/properties/ports

    properties:
      port@0:
        $ref: /schemas/graph.yaml#/properties/port
        description: Parallel RGB input from DPI0

      port@1:
        $ref: /schemas/graph.yaml#/properties/port
        description: LVDS output to a panel or bridge

    required:
      - port@0
      - port@1

required:
  - compatible
  - reg
  - reg-names
  - clocks
  - clock-names
  - mediatek,mmsys
  - ports

additionalProperties: false

examples:
  - |
    soc {
        #address-cells = <2>;
        #size-cells = <2>;

        lvds@14016000 {
            compatible = "mediatek,mt8127-lvds";
            reg = <0 0x14016000 0 0x1000>, <0 0x10010400 0 0x100>;
            reg-names = "tx", "ana";
            clocks = <&mmsys 34>, <&mmsys 35>, <&mipi_tx0>;
            clock-names = "pixel", "cts", "pll";
            mediatek,mmsys = <&mmsys>;

            ports {
                #address-cells = <1>;
                #size-cells = <0>;

                port@0 {
                    reg = <0>;

                    lvds_in: endpoint {
                        remote-endpoint = <&dpi0_out>;
                    };
                };

                port@1 {
                    reg = <1>;

                    lvds_out: endpoint {
                        remote-endpoint = <&panel_in>;
                    };
                };
            };
        };
    };
```

## Documentation/devicetree/bindings/display/panel/himax,hx8282.yaml
```yaml
# SPDX-License-Identifier: (GPL-2.0-only OR BSD-2-Clause)
%YAML 1.2
---
$id: http://devicetree.org/schemas/display/panel/himax,hx8282.yaml#
$schema: http://devicetree.org/meta-schemas/core.yaml#

title: Himax HX8282 based LVDS panels

maintainers:
  - Marc Lainez <marc.lainez@gmail.com>

description:
  The Himax HX8282 is a timing controller and source driver with an LVDS
  input for 1024x600 TFT panels. It is configured by straps on the panel and
  needs no register setup, so the panel timings are given by the
  panel-timing node.

allOf:
  - $ref: panel-common.yaml#
  - $ref: /schemas/display/lvds.yaml#

properties:
  compatible:
    items:
      - enum:
          # Lenovo Tab3 7 Essential (TB3-710F) 7" WSVGA (1024x600) panel
          - lenovo,tb3-710f-panel
      - const: himax,hx8282

  iovcc-supply:
    description: Logic supply of the HX8282

  vdd-supply:
    description: Panel power supply

  reset-gpios:
    maxItems: 1

  standby-gpios:
    maxItems: 1
    description: GPIO connected to the STBYB input (active low)

  enable-gpios:
    maxItems: 1
    description: GPIO enabling the panel power stage

required:
  - compatible
  - iovcc-supply
  - vdd-supply
  - reset-gpios
  - standby-gpios
  - enable-gpios
  - data-mapping
  - width-mm
  - height-mm
  - panel-timing
  - port

unevaluatedProperties: false

examples:
  - |
    #include <dt-bindings/gpio/gpio.h>

    panel {
        compatible = "lenovo,tb3-710f-panel", "himax,hx8282";
        iovcc-supply = <&vgp1>;
        vdd-supply = <&lcd_3v3>;
        reset-gpios = <&pio 89 GPIO_ACTIVE_LOW>;
        standby-gpios = <&pio 88 GPIO_ACTIVE_LOW>;
        enable-gpios = <&pio 44 GPIO_ACTIVE_HIGH>;
        backlight = <&backlight>;
        data-mapping = "vesa-24";
        width-mm = <154>;
        height-mm = <86>;

        panel-timing {
            clock-frequency = <52000000>;
            hactive = <1024>;
            vactive = <600>;
            hfront-porch = <160>;
            hback-porch = <160>;
            hsync-len = <10>;
            vfront-porch = <12>;
            vback-porch = <23>;
            vsync-len = <10>;
        };

        port {
            panel_in: endpoint {
                remote-endpoint = <&lvds_out>;
            };
        };
    };
```

## Documentation/devicetree/bindings/phy/mediatek,mt8127-usb2-phy.yaml
```yaml
# SPDX-License-Identifier: (GPL-2.0-only OR BSD-2-Clause)
%YAML 1.2
---
$id: http://devicetree.org/schemas/phy/mediatek,mt8127-usb2-phy.yaml#
$schema: http://devicetree.org/meta-schemas/core.yaml#

title: MediaTek MT8127 USB2 PHY

maintainers:
  - Marc Lainez <marc.lainez@gmail.com>

description:
  The USB2 PHY of the MT8127 SoC, which feeds the MUSB controller. Until there
  is a clock driver for the SoC, the PHY driver ungates the USB0 clock in the
  peripheral configuration block and enables the 48 MHz USB clock in the
  APMIXEDSYS itself.

properties:
  $nodename:
    pattern: "^usb-phy@[0-9a-f]+$"

  compatible:
    const: mediatek,mt8127-usb2-phy

  reg:
    items:
      - description: USB2 PHY registers
      - description: PERICFG registers (USB0 clock gate)
      - description: APMIXEDSYS registers (48 MHz USB clock enable)

  "#phy-cells":
    const: 0

required:
  - compatible
  - reg
  - "#phy-cells"

additionalProperties: false

examples:
  - |
    usb-phy@11210000 {
        compatible = "mediatek,mt8127-usb2-phy";
        reg = <0x11210000 0x1000>,
              <0x10003000 0x1000>,
              <0x10209000 0x1000>;
        #phy-cells = <0>;
    };
```

## Documentation/devicetree/bindings/sound/mediatek,mt8127-afe-pcm.yaml
```yaml
# SPDX-License-Identifier: (GPL-2.0-only OR BSD-2-Clause)
%YAML 1.2
---
$id: http://devicetree.org/schemas/sound/mediatek,mt8127-afe-pcm.yaml#
$schema: http://devicetree.org/meta-schemas/core.yaml#

title: MediaTek MT8127 audio front-end

maintainers:
  - Marc Lainez <marc.lainez@gmail.com>

description:
  The audio front-end (AFE) of the MT8127 moves PCM samples between memory
  and its audio interfaces, among them the ADDA interface to the codec of the
  MT6323 PMIC. Its registers are part of the audsys block, so the AFE is
  described as the audio-controller child node of the audsys syscon.

properties:
  compatible:
    const: mediatek,mt8127-afe-pcm

  interrupts:
    maxItems: 1

  clocks:
    items:
      - description: infracfg audio bus clock
      - description: topckgen audio clock mux
      - description: topckgen audio internal bus clock mux
      - description: audsys AFE clock gate

  clock-names:
    items:
      - const: infra_sys_audio_clk
      - const: top_pdn_audio
      - const: top_pdn_aud_intbus
      - const: aud_afe

  memory-region:
    description: memory region for the audio DMA buffers
    maxItems: 1

required:
  - compatible
  - interrupts
  - clocks
  - clock-names

additionalProperties: false

examples:
  - |
    #include <dt-bindings/clock/mt8127-clk.h>
    #include <dt-bindings/interrupt-controller/arm-gic.h>
    #include <dt-bindings/interrupt-controller/irq.h>

    audio-controller {
        compatible = "mediatek,mt8127-afe-pcm";
        interrupts = <GIC_SPI 104 IRQ_TYPE_LEVEL_LOW>;
        clocks = <&infracfg CLK_INFRA_AUDIO>,
                 <&topckgen CLK_TOP_AUDIO_SEL>,
                 <&topckgen CLK_TOP_AUD_INTBUS_SEL>,
                 <&audsys CLK_AUD_AFE>;
        clock-names = "infra_sys_audio_clk",
                      "top_pdn_audio",
                      "top_pdn_aud_intbus",
                      "aud_afe";
    };
```

## Documentation/devicetree/bindings/sound/mediatek,mt8127-mt6323.yaml
```yaml
# SPDX-License-Identifier: (GPL-2.0-only OR BSD-2-Clause)
%YAML 1.2
---
$id: http://devicetree.org/schemas/sound/mediatek,mt8127-mt6323.yaml#
$schema: http://devicetree.org/meta-schemas/core.yaml#

title: MediaTek MT8127 sound card with the MT6323 codec

maintainers:
  - Marc Lainez <marc.lainez@gmail.com>

description:
  Sound card of MT8127 boards that use the codec of the MT6323 PMIC. The
  headphone outputs of the codec can also drive an external speaker
  amplifier, and a GPIO can report the jack switch.

properties:
  compatible:
    const: mediatek,mt8127-mt6323

  model:
    $ref: /schemas/types.yaml#/definitions/string
    description: User specified audio sound card name

  mediatek,platform:
    $ref: /schemas/types.yaml#/definitions/phandle
    description: The phandle of the MT8127 audio front-end.

  mediatek,audio-codec:
    $ref: /schemas/types.yaml#/definitions/phandle
    description: The phandle of the MT6323 audio codec node.

  spk-en-gpios:
    maxItems: 1
    description: Enable line of the external speaker amplifier.

  hp-det-gpios:
    maxItems: 1
    description: Headphone jack switch, asserted while a plug is inserted.

required:
  - compatible
  - mediatek,platform
  - mediatek,audio-codec

additionalProperties: false

examples:
  - |
    #include <dt-bindings/gpio/gpio.h>

    sound {
        compatible = "mediatek,mt8127-mt6323";
        model = "Lenovo Tab3 7";
        mediatek,platform = <&afe>;
        mediatek,audio-codec = <&mt6323_codec>;
        spk-en-gpios = <&pio 30 GPIO_ACTIVE_HIGH>;
        hp-det-gpios = <&pio 26 GPIO_ACTIVE_LOW>;
    };
```
